## imx6dq/pico_imx6/android_addition_defconfig
```kconfig
CONFIG_CLD_HL_SDIO_CORE=y
CONFIG_VIDEO_MXC_CSI_CAMERA=y
CONFIG_MXC_CAMERA_OV5645_MIPI=y
```

## imx7d/tep1_imx7/android_addition_defconfig
```kconfig
CONFIG_CLD_HL_SDIO_CORE=y
CONFIG_VIDEO_MXC_CSI_CAMERA_LEGACY=y
CONFIG_MXC_CAMERA_OV5645_MIPI_V2=y
```

## imx8m/edm_g_imx8mn/android_addition_defconfig
```kconfig
CONFIG_LIBNVDIMM=y
CONFIG_OF_PMEM=y
CONFIG_TYPEC_TCPM=n
CONFIG_TYPEC_TCPCI=n
CONFIG_CLD_HL_SDIO_CORE=y
```

## imx8m/edm_g_imx8mp/android_sim8202_addition_defconfig
```kconfig
CONFIG_LIBNVDIMM=y
CONFIG_OF_PMEM=y
CONFIG_CLD_HL_SDIO_CORE=y
CONFIG_USB_NET_RNDIS_HOST=y
CONFIG_USB_SERIAL_QUALCOMM=y
CONFIG_USB_SERIAL_OPTION=y
CONFIG_USB_NET_QMI_WWAN=n
CONFIG_USB_NET_QMI_WWAN_SIM8202=y
```
